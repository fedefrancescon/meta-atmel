## conf/machine/sam9x60-hid.conf
```bitbake
#@TYPE: Machine
#@SOC: SAM9x20
#@NAME: ATMEL SAM9x20 based HID
#@DESCRIPTION: Machine configuration for Higeco HID

include conf/machine/sam9x60ek.conf

MACHINEOVERRIDES = "at91sam9:sam9x60:sam9x60ek:"

AT91BOOTSTRAP_MACHINE = "sam9x60ek"
AT91BOOTSTRAP_CONFIG_sam9x60ek = "sam9x60-hidnf_uboot"
AT91BOOTSTRAP_LOAD = "hid-nandflashboot-uboot"

UBOOT_MACHINE = "sam9x60-hid_nandflash_defconfig"


# Build both EVB (for testing) and HID
KERNEL_DEVICETREE = " at91-sam9x60ek.dtb at91-sam9x60-hid.dtb "

# For 128MB flash - TBD
UBINIZE_ARGS = "-m 2048 -p 128KiB -s 2048"
MKUBIFS_ARGS = "-m 2048 -e 126976 -c 1944"


# We want to use systemd from dunfell
DISTRO_FEATURES_append = " systemd systemd-serialgetty"
DISTRO_FEATURES_BACKFILL_CONSIDERED += "sysvinit"
VIRTUAL-RUNTIME_init_manager = "systemd"
VIRTUAL-RUNTIME_initscripts = "systemd-compat-units"
PACKAGECONFIG_append_pn-systemd = " resolved networkd"

# Remove some features really not needed for HID
DISTRO_FEATURES_remove = " alsa pcmcia pci opengl pulseaudio x11 nfc 3g bluetooth ptest"

# Do not install kernel image in /boot: we have it raw in NAND and on separate partition on SD
RDEPENDS_${KERNEL_PACKAGE_NAME}-base = ""


PACKAGECONFIG_append_pn-openssl = " cryptodev-linux"
PACKAGECONFIG_append_pn-gnutls = " cryptodev-linux"

PACKAGE_CLASSES = "package_ipk"
```
